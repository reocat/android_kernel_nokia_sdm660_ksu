## drivers/net/can/spi/Kconfig
```kconfig
menu "CAN SPI interfaces"
	depends on SPI

config CAN_HI311X
	tristate "Holt HI311x SPI CAN controllers"
	depends on CAN_DEV && SPI && HAS_DMA
	---help---
	  Driver for the Holt HI311x SPI CAN controllers.

config CAN_MCP251X
	tristate "Microchip MCP251x and MCP25625 SPI CAN controllers"
	depends on HAS_DMA
	---help---
	  Driver for the Microchip MCP251x and MCP25625 SPI CAN
	  controllers.

config CAN_MCP25XXFD
	tristate "Microchip MCP25xxFD SPI CAN controllers"
	depends on HAS_DMA
	help
	  The driver for the Microchip MCP25XXFD SPI FD-CAN
	  controller family.
	  Say yes here to build support for SPI to CAN devices
	  mcp25xxfd. To compilethis driver as a module, choose
	  M here: the module will be called mcp25xxfd.

config CAN_RH850
	tristate "Renesas RH850 SPI CAN controller"
	depends on HAS_DMA
	---help---
	  Driver for the Renesas RH850 SPI CAN controller.

config CAN_K61
	tristate "Freescale K61 SPI CAN controllers"
	depends on SPI
	---help---
	  Driver for the Freescale K61 SPI CAN controllers.

config QTI_CAN
	tristate "Unified driver for QTI CAN controllers"
	depends on SPI
	---help---
	  Unified driver for QTI CAN controllers.
endmenu
```

## drivers/staging/android/Kconfig
```kconfig
menu "Android"

if ANDROID

config ASHMEM
	bool "Enable the Anonymous Shared Memory Subsystem"
	default n
	depends on SHMEM
	help
	  The ashmem subsystem is a new shared memory allocator, similar to
	  POSIX SHM but with different behavior and sporting a simpler
	  file-based API.

	  It is, in theory, a good memory allocator for low-memory devices,
	  because it can discard shared memory units when under memory pressure.

config ANDROID_VSOC
	tristate "Android Virtual SoC support"
	default n
	depends on PCI_MSI
	help
	  This option adds support for the Virtual SoC driver needed to boot
	  a 'cuttlefish' Android image inside QEmu. The driver interacts with
	  a QEmu ivshmem device. If built as a module, it will be called vsoc.

config ONESHOT_SYNC
	bool "One shot sync objects"
	depends on SYNC
	help
	  This sync driver provides a way to create sync objects that may
	  be signaled by userspace. Unlike other sync objects, the
	  sync objects created by this driver may be signaled in any order
	  without changing the state of other sync objects on the timeline.

config ONESHOT_SYNC_USER
	bool "Userspace API for ONESHOT_SYNC"
	depends on SYNC
	help
	  Provide a userspace API for creating oneshot sync objects.

config ANDROID_VSOC
	tristate "Android Virtual SoC support"
	default n
	depends on PCI_MSI
	---help---
	  This option adds support for the Virtual SoC driver needed to boot
	  a 'cuttlefish' Android image inside QEmu. The driver interacts with
	  a QEmu ivshmem device. If built as a module, it will be called vsoc.

source "drivers/staging/android/ion/Kconfig"

endif # if ANDROID

endmenu
```
